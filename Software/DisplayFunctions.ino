void cellChange(byte *arrPtr,char state) {
  if(state == REMOVE){
    if (currentEmptyCell == 3) return;
    else{
      currentEmptyCell++;
      char index = 4 * currentEmptyCell + 2 * (currentEmptyCell - 1);
      for (char j = index; j < index + 5; j++) arrPtr[j] = 0x01;
    }
  }
  else if (state == ADD){
    if (currentEmptyCell == 0) return;
    else{
      char index = 4 * currentEmptyCell + 2 * (currentEmptyCell - 1);
      for (char j = index; j < index + 5; j++) arrPtr[j] = 0xfd;
      currentEmptyCell--;
    }
  }
  lcd.setCursor(55, 0);
  lcd.drawBitmap(battery_Bitmap, BATTERY_WIDHT, ceil(BATTERY_HEIGHT / 8.0));
}

void sparkToggle(void) {
  if (millis() - prev > 1000) {
   prev = millis();
   lcd.setCursor(47, 0);
   if (toggle == 0) {
     lcd.drawBitmap(chargSpark_Bitmap, CHARGESPARK_WIDHT, ceil(CHARGESPARK_HEIGHT / 8.0));
     toggle = 1;
   }
   else {
     drawing_clear(47,0,2,1);// delete spark drawing.
     toggle = 0;
   }
  }
}

void chargingMode(void) {
  static char i = 0;
  if (millis() - prev1 > 500 && flag == 0) {
    i++;
    cellChange(battery_Bitmap,REMOVE);
    lcd.setCursor(55, 0);
    lcd.drawBitmap(battery_Bitmap, BATTERY_WIDHT, ceil(BATTERY_HEIGHT / 8.0));
    if (i == 3) {flag = 1 ; i = 0; }
    prev1 = millis();
  }
  else if (millis() - prev1 > 500 && flag == 1) {
    i++;
    cellChange(battery_Bitmap,ADD);
    lcd.setCursor(55, 0);
    lcd.drawBitmap(battery_Bitmap, BATTERY_WIDHT, ceil(BATTERY_HEIGHT / 8.0));
    if (i == 3) { flag = 0; i = 0; }
    prev1 = millis();
  }
}
/*
  function used to remove a drawing.
  requires starting points x,y 
  it removes by drawing "space" , 
  note the space takes more than one pixel, 
  that's why we don't send the true size of the drawing we want to remove.
*/
void drawing_clear(char width, char height,char coloums,char pixels){
  char x=width, y=height, coloum = 0 , pixel = 0;
  for(coloum = 0; coloum < coloums; coloum++)
    for(pixel=0; pixel<pixels; pixel++) 
    {
      lcd.setCursor(x+pixel,y+coloum);
      lcd.print(" ");
    }
}

/*
  byte battery_3Cell_Bitmap[] = {
  0xfc, 0xfc, 0xff, 0x01, 0xfd, 0xfd, 0xfd, 0xfd, 0xfd, 0x01, 0xfd, 0xfd, 0xfd, 0xfd, 0xfd, 0x01, 0xfd, 0xfd, 0xfd, 0xfd, 0xfd, 0x01, 0xff,
  0x00, 0x00, 0x03, 0x02, 0x02, 0x02, 0x02, 0x02, 0x02, 0x02, 0x02, 0x02, 0x02, 0x02, 0x02, 0x02, 0x02, 0x02, 0x02, 0x02, 0x02, 0x02, 0x03
  };
  byte battery_2Cell_Bitmap[] = {
  0xfc, 0xfc, 0xff, 0x01, 0x01, 0x01, 0x01, 0x01, 0x01, 0x01, 0xfd, 0xfd, 0xfd, 0xfd, 0xfd, 0x01, 0xfd, 0xfd, 0xfd, 0xfd, 0xfd, 0x01, 0xff,
  0x00, 0x00, 0x03, 0x02, 0x02, 0x02, 0x02, 0x02, 0x02, 0x02, 0x02, 0x02, 0x02, 0x02, 0x02, 0x02, 0x02, 0x02, 0x02, 0x02, 0x02, 0x02, 0x03
  };
  byte battery_1Cell_Bitmap[] = {
  0xfc, 0xfc, 0xff, 0x01, 0x01, 0x01, 0x01, 0x01, 0x01, 0x01, 0x01, 0x01, 0x01, 0x01, 0x01, 0x01, 0xfd, 0xfd, 0xfd, 0xfd, 0xfd, 0x01, 0xff,
  0x00, 0x00, 0x03, 0x02, 0x02, 0x02, 0x02, 0x02, 0x02, 0x02, 0x02, 0x02, 0x02, 0x02, 0x02, 0x02, 0x02, 0x02, 0x02, 0x02, 0x02, 0x02, 0x03
  };
  byte battery_0Cell_Bitmap[] = {
  0xfc, 0xfc, 0xff, 0x01, 0x01, 0x01, 0x01, 0x01, 0x01, 0x01, 0x01, 0x01, 0x01, 0x01, 0x01, 0x01, 0x01, 0x01, 0x01, 0x01, 0x01, 0x01, 0xff,
  0x00, 0x00, 0x03, 0x02, 0x02, 0x02, 0x02, 0x02, 0x02, 0x02, 0x02, 0x02, 0x02, 0x02, 0x02, 0x02, 0x02, 0x02, 0x02, 0x02, 0x02, 0x02, 0x03
  };
*/
